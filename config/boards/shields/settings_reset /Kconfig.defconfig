## config/boards/shields/settings_reset /Kconfig.defconfig
```kconfig
# Copyright (c) 2020 The ZMK Contributors
# SPDX-License-Identifier: MIT

if SHIELD_SETTINGS_RESET_R

config ZMK_KEYBOARD_NAME
	default "SETTINGS RESET_R"

config ZMK_SPLIT
    default y

config ZMK_SPLIT_ROLE_CENTRAL
    default y

endifendif

if SHIELD_SETTINGS_RESET_L

config ZMK_KEYBOARD_NAME
    default "SETTINGS RESET_L"

config ZMK_SPLIT
    default y

endif
```

## config/boards/shields/settings_reset /Kconfig.shield
```kconfig
# Copyright (c) 2020 The ZMK Contributors
# SPDX-License-Identifier: MIT

config SHIELD_SETTINGS_RESET_R
	def_bool $(shields_list_contains,settings_reset_R)

config SHIELD_SETTINGS_RESET_L
	def_bool $(shields_list_contains,settings_reset_L)
```
